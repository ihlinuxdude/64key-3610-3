## 64key-3610-3/config/boards/shields/charybdis_nano/Kconfig.defconfig
```kconfig
if SHIELD_CHARYBDIS_NANO_RIGHT

config ZMK_KEYBOARD_NAME
	default "64key-ball"

config ZMK_SPLIT_BLE_ROLE_CENTRAL
	default y

endif

if SHIELD_CHARYBDIS_NANO_LEFT || SHIELD_CHARYBDIS_NANO_RIGHT

config ZMK_SPLIT
	default y
	
endif
```

## 64key-3610-3/config/boards/shields/charybdis_nano/Kconfig.shield
```kconfig
config SHIELD_CHARYBDIS_NANO_LEFT
    def_bool $(shields_list_contains,charybdis_nano_left)

config SHIELD_CHARYBDIS_NANO_RIGHT
    def_bool $(shields_list_contains,charybdis_nano_right)
```

## config/west.yml
```yaml
manifest:
  remotes:
    - name: zmkfirmware
      url-base: https://github.com/zmkfirmware
    - name: ihlinuxdude
      url-base: https://github.com/ihlinuxdude
    - name: badjeff
      url-base: https://github.com/badjeff
  projects:
    - name: zmk
      remote: zmkfirmware
      revision: main
      import: app/west.yml
    - name: zmk-pmw3610-driver64key
      remote: ihlinuxdude
      revision: main
    - name: zmk-input-behavior-listener
      remote: badjeff
      revision: main
  self:
    path: config
```

## modules/pointer-rotate/dts/bindings/zmk,pointer-rotate.yaml
```yaml
title: ZMK Pointer Rotate Processor
type: zmk,input-processor
properties:
  angle-deg:
    type: int
    required: true
    description: Rotation angle in degrees (positive = CCW)
```
